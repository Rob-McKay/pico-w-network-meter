## CMakeLists.txt
```
# Copyright (c) 2026 Rob McKay
# SPDX-License-Identifier: Apache-2.0

cmake_minimum_required(VERSION 3.20.0)

include(${CMAKE_CURRENT_SOURCE_DIR}/../../cmake/toolchain.cmake)
find_package(Zephyr REQUIRED HINTS $ENV{ZEPHYR_BASE})
project(test_ui_render)

include(${CMAKE_CURRENT_SOURCE_DIR}/../../cmake/strict.cmake)
meter_strict_warnings(app)

include(${CMAKE_CURRENT_SOURCE_DIR}/../../cmake/meter_core.cmake)
meter_core(app)

set(APP_SRC ${CMAKE_CURRENT_SOURCE_DIR}/../../app/src)
target_include_directories(app PRIVATE ${APP_SRC})
target_sources(app PRIVATE
  src/main.c
  src/fake_display.c
  ${APP_SRC}/ui.c
  ${APP_SRC}/recommend.c
  ${APP_SRC}/gfx.c
)
```

## Kconfig
```
# Copyright (c) 2026 Rob McKay
# SPDX-License-Identifier: Apache-2.0

module = METER
module-str = Network meter
source "subsys/logging/Kconfig.template.log_config"

source "Kconfig.zephyr"
```

## prj.conf
```kconfig
# Copyright (c) 2026 Rob McKay
# SPDX-License-Identifier: Apache-2.0
CONFIG_ZTEST=y
CONFIG_ASAN=y
CONFIG_DISPLAY=y
# The fake panel (src/fake_display.c) stands in for the SDL window.
CONFIG_SDL_DISPLAY=n
# Only for its fonts, as in the firmware.
CONFIG_CHARACTER_FRAMEBUFFER=y
CONFIG_LOG=y
# The restart note's checksum (boot_record.c).
CONFIG_CRC=y
```

## boards/native_sim_native_64.overlay
```dts
/*
 * Copyright (c) 2026 Rob McKay
 *
 * SPDX-License-Identifier: Apache-2.0
 *
 * A 320x240 RGB565 panel like the meter's, kept in memory by
 * src/fake_display.c, in place of native_sim's SDL window.
 */

#include <zephyr/dt-bindings/display/panel.h>

/ {
	chosen {
		zephyr,display = &test_display;
	};

	test_display: test_display {
		compatible = "meter,test-display";
		width = <320>;
		height = <240>;
		pixel-format = <PANEL_PIXEL_FORMAT_RGB_565X>;
	};
};

&sdl_dc {
	status = "disabled";
};
```

## dts/bindings/meter,test-display.yaml
```yaml
# Copyright (c) 2026 Rob McKay
# SPDX-License-Identifier: Apache-2.0

description: |
  In-memory RGB565 panel for the UI tests (tests/ui_render): keeps what is
  written to it so the tests can check pixels and save screenshots.

compatible: "meter,test-display"

include: display-controller.yaml

properties:
  pixel-format:
    type: int
    required: true
    description: The panel's pixel format (PANEL_PIXEL_FORMAT_...).
```

## src/main.c
```c
/*
 * Copyright (c) 2026 Rob McKay
 *
 * SPDX-License-Identifier: Apache-2.0
 *
 * The meter's screens (ui.c, gfx.c), drawn on an in-memory 320x240 panel:
 * pixels where the layout puts them, and screenshots of each screen in
 * out/screens/ when scripts/test.sh runs the test.
 */

#include <stdbool.h>
#include <stdio.h>
#include <stdint.h>

#include <zephyr/ztest.h>
#include <zephyr/sys/util.h>

#include "boot_record.h"
#include "chan_stats.h"
#include "fake_display.h"
#include "gfx.h"
#include "ui.h"

/* Layout, as ui.c works it out for 320x240. */
#define BAR_H        20
#define CHART_BOTTOM (240 - BAR_H - 16 - 4)
#define AXIS_W       34
#define COL_W        ((320 - AXIS_W) / 13)
/* Rows of the chart's grid lines at -60 dBm (labelled) and -50 dBm: CHART_BOTTOM less
 * 40 and 50 dB of the 70 dB scale, which is 162 pixels tall.
 */
#define ROW_MINUS_60 (CHART_BOTTOM - ((40 * 162) / 70))
#define ROW_MINUS_50 (CHART_BOTTOM - ((50 * 162) / 70))
#define LIST_TOP     (BAR_H + 2)
#define LIST_NAME_W  (24 * 10)
#define LIST_CHAN_X  (LIST_NAME_W + 8)
#define LIST_RSSI_X  (LIST_CHAN_X + (3 * 10))
/* The 5 GHz chart: six blocks of four 10-pixel columns, 6 pixels apart,
 * centred beside the axis (270 of 286 pixels).
 */
#define X0_5G        (AXIS_W + ((320 - AXIS_W - 270) / 2))

static struct chan_stats stats;

/**
 * @brief Add an access point to the test scan.
 *
 * @param id Last byte of its BSSID.
 * @param ssid Network name.
 * @param channel Channel.
 * @param rssi dBm.
 * @param secured Not an open network.
 *
 * @sideeffects Adds the access point to the test's @c stats. errno may be set by snprintf()
 *              (only on an output error).
 */
static void add(uint8_t id, const char *ssid, uint8_t channel, int8_t rssi, bool secured)
{
	struct chan_ap ap = {
		.bssid = {0x02, 0x1f, 0x3c, 0xa2, 0x7f, id},
		.channel = channel,
		.rssi = rssi,
		.secured = secured,
		.freshness = CHAN_FRESH,
	};

	(void)snprintf(ap.ssid, sizeof(ap.ssid), "%s", ssid);
	zassert_ok(chan_stats_add(&stats, &ap));
}


/**
 * @brief Start the display and fill in a scan: busy on 1, a little on 4-6,
 *        a weak hidden network on 9, little near 11 (so 11 is recommended).
 *
 * @return NULL: no fixture.
 *
 * @sideeffects Starts the fake panel (ui_init()) and fills the test's @c stats. errno may be
 *              set by snprintf() (only on an output error).
 */
static void *setup(void)
{
	zassert_ok(ui_init());

	chan_stats_reset(&stats);
	add(1, "HomeNetwork", 1, -42, true);
	add(2, "HomeNetwork-Guest", 1, -48, true);
	add(3, "JurassicFibre_UID35630", 1, -67, true);
	add(4, "CoffeeShop", 6, -81, false);
	add(5, "Printer", 4, -88, true);
	add(6, "", 9, -90, true);

	return NULL;
}


/**
 * @brief Left edge of a channel's column on the chart.
 *
 * @param ch Channel.
 * @return x.
 *
 * @sideeffects None; errno unchanged.
 */
static int column_x(int ch)
{
	return AXIS_W + ((ch - 1) * COL_W);
}


/**
 * @brief Tell whether part of a line of text on the fake panel has any
 *        pixel of a colour.
 *
 * @param y Top of the line.
 * @param x0 Left edge of the part to look at.
 * @param x1 Its right edge, exclusive.
 * @param colour The colour.
 * @return True if any pixel in the part's 16 rows is @p colour.
 *
 * @sideeffects None; errno unchanged.
 */
static bool row_has_colour(int y, int x0, int x1, uint16_t colour)
{
	for (int dy = 0; dy < 16; dy++) {
		for (int x = x0; x < x1; x++) {
			if (fake_display_pixel(x, y + dy) == colour) {
				return true;
			}
		}
	}

	return false;
}


/**
 * @brief Bars are coloured by how busy the channel is; empty ones aren't drawn.
 *
 * @sideeffects Draws on the fake panel and saves it to out/screens/channels.ppm. errno may be
 *              set by snprintf() (only on an output error).
 */
ZTEST(meter_ui, test_channel_bars)
{
	ui_show(UI_VIEW_CHANNELS, CHAN_BAND_2G4, &stats, 1, 0, true);

	zassert_equal(fake_display_pixel(column_x(1) + (COL_W / 2), CHART_BOTTOM - 1),
		      gfx_rgb(230, 40, 40), "channel 1: busy, red");
	zassert_equal(fake_display_pixel(column_x(6) + (COL_W / 2), CHART_BOTTOM - 1),
		      gfx_rgb(255, 170, 0), "channel 6: moderate, amber");
	zassert_equal(fake_display_pixel(column_x(13) + (COL_W / 2), CHART_BOTTOM - 1),
		      gfx_rgb(0, 0, 0), "channel 13: nothing heard, no bar");
	zassert_equal(fake_display_pixel(column_x(1), CHART_BOTTOM - 1), gfx_rgb(0, 0, 0),
		      "the gap beside a bar is background");
	zassert_equal(fake_display_pixel(column_x(2) + (COL_W / 2), CHART_BOTTOM - 1),
		      gfx_fade(gfx_rgb(230, 40, 40), 153),
		      "channel 2: no network of its own, dim spill-over from 1");
	zassert_equal(
		fake_display_pixel(column_x(1) + 4, ROW_MINUS_60),
		gfx_fade(gfx_rgb(230, 40, 40), 153),
		"channel 1: its two weaker networks interfere with the strongest, to -48 dBm");
	zassert_equal(fake_display_pixel(column_x(1) + 4, CHART_BOTTOM - ((60 * 162) / 70)),
		      gfx_rgb(0, 0, 0), "background beside the bright bar above that, at -40 dBm");
	(void)fake_display_save_ppm("out/screens/channels.ppm");
}


/**
 * @brief The recommended channel's number is highlighted, the others aren't.
 *
 * @sideeffects Draws on the fake panel. errno may be set by snprintf() (only on an output
 *              error).
 */
ZTEST(meter_ui, test_recommended_highlight)
{
	ui_show(UI_VIEW_CHANNELS, CHAN_BAND_2G4, &stats, 1, 0, true);

	zassert_equal(chan_stats_recommend(&stats), 11);
	zassert_equal(fake_display_pixel(column_x(11), CHART_BOTTOM + 4), gfx_rgb(0, 210, 255));
	zassert_equal(fake_display_pixel(column_x(6), CHART_BOTTOM + 4), gfx_rgb(0, 0, 0));
}


/**
 * @brief Grid lines cross the empty columns and the gaps beside bars, the
 *        y axis runs down the left of the chart, and a partial redraw keeps
 *        both.
 *
 * @sideeffects Draws on the fake panel. errno may be set by snprintf() (only on an output
 *              error).
 */
ZTEST(meter_ui, test_grid_and_axis)
{
	uint16_t labelled = gfx_rgb(80, 80, 80);
	uint16_t unlabelled = gfx_rgb(40, 40, 40);

	ui_show(UI_VIEW_CHANNELS, CHAN_BAND_2G4, &stats, 1, 0, true);
	ui_show(UI_VIEW_CHANNELS, CHAN_BAND_2G4, &stats, 2, 0, false);

	zassert_equal(fake_display_pixel(column_x(13) + (COL_W / 2), ROW_MINUS_60), labelled,
		      "grid line across an empty column");
	zassert_equal(fake_display_pixel(column_x(13) + (COL_W / 2), ROW_MINUS_50), unlabelled,
		      "fainter grid line between the labelled ones");
	zassert_equal(fake_display_pixel(column_x(13) + (COL_W / 2), ROW_MINUS_60 + 1),
		      gfx_rgb(0, 0, 0), "background between grid lines");
	zassert_equal(fake_display_pixel(column_x(1), ROW_MINUS_60), labelled,
		      "grid line in the gap beside a bar");
	zassert_equal(fake_display_pixel(column_x(1) + (COL_W / 2), ROW_MINUS_60),
		      gfx_rgb(230, 40, 40), "the bar covers the grid line");
	zassert_equal(fake_display_pixel(AXIS_W - 1, ROW_MINUS_60 + 1), gfx_rgb(150, 150, 150),
		      "y axis");
	zassert_equal(fake_display_pixel(AXIS_W - 1, CHART_BOTTOM - 1), gfx_rgb(150, 150, 150),
		      "y axis reaches the bottom of the bars");
	zassert_equal(fake_display_pixel(AXIS_W - 1, CHART_BOTTOM), gfx_rgb(0, 0, 0),
		      "and stops there");
}


/**
 * @brief The list shows the strongest network first, its signal strength
 *        in green; a weak one's in red; a hidden network's name in grey.
 *
 * @sideeffects Draws on the fake panel and saves it to out/screens/networks.ppm. errno may be
 *              set by snprintf() (only on an output error).
 */
ZTEST(meter_ui, test_network_list)
{
	ui_show(UI_VIEW_NETWORKS, CHAN_BAND_2G4, &stats, 2, 0, true);

	zassert_true(row_has_colour(LIST_TOP + 2, LIST_RSSI_X, 320, gfx_rgb(0, 200, 80)),
		     "-42 dBm: green");
	zassert_false(row_has_colour(LIST_TOP + 2, LIST_RSSI_X, 320, gfx_rgb(230, 40, 40)));
	zassert_true(
		row_has_colour(LIST_TOP + (4 * 20) + 2, LIST_RSSI_X, 320, gfx_rgb(230, 40, 40)),
		"5th, -88 dBm: red");
	zassert_true(
		row_has_colour(LIST_TOP + (5 * 20) + 2, 0, LIST_NAME_W, gfx_rgb(150, 150, 150)),
		"6th: the hidden network, named in grey");
	zassert_false(row_has_colour(LIST_TOP + (6 * 20) + 2, 0, 320, gfx_rgb(255, 255, 255)),
		      "no 7th network");
	(void)fake_display_save_ppm("out/screens/networks.ppm");
}


/**
 * @brief Header and footer bars are drawn edge to edge.
 *
 * @sideeffects Draws on the fake panel. errno may be set by snprintf() (only on an output
 *              error).
 */
ZTEST(meter_ui, test_bars)
{
	uint16_t bar = gfx_rgb(0, 50, 110);

	ui_show(UI_VIEW_CHANNELS, CHAN_BAND_2G4, &stats, 3, 0, true);
	zassert_equal(fake_display_pixel(0, 0), bar);
	zassert_equal(fake_display_pixel(319, BAR_H - 1), bar);
	zassert_equal(fake_display_pixel(0, 240 - BAR_H), bar);
	zassert_equal(fake_display_pixel(319, 239), bar);
}


/**
 * @brief Ageing networks are drawn darker; the static labels are not.
 *
 * @sideeffects Overwrites its own static copy of the scan; draws on the fake panel and saves it
 *              to out/screens/faded.ppm. errno may be set by snprintf() (only on an output
 *              error).
 */
ZTEST(meter_ui, test_faded)
{
	static struct chan_stats faded;

	faded = stats;
	for (size_t i = 0; i < faded.ap_count; i++) {
		faded.aps[i].freshness = 128;
	}
	ui_show(UI_VIEW_CHANNELS, CHAN_BAND_2G4, &faded, 4, 0, true);
	zassert_equal(fake_display_pixel(column_x(1) + (COL_W / 2), CHART_BOTTOM - 1),
		      gfx_fade(gfx_rgb(230, 40, 40), 128), "channel 1's bar at half brightness");
	zassert_equal(fake_display_pixel(column_x(11), CHART_BOTTOM + 4), gfx_rgb(0, 210, 255),
		      "the recommended channel's highlight does not fade");
	(void)fake_display_save_ppm("out/screens/faded.ppm");
}


/**
 * @brief A name long enough to be shortened fills its column, and still
 *        leaves a gap before a two-digit channel number.
 *
 * @sideeffects Draws on the fake panel. errno unchanged.
 */
ZTEST(meter_ui, test_name_gap)
{
	static struct chan_stats one;
	struct chan_ap ap = {
		.ssid = "ABCDEFGHIJKLMNOPQRSTUVWXYZ012345",
		.bssid = {0x02, 0x1f, 0x3c, 0xa2, 0x7f, 0x40},
		.channel = 11,
		.rssi = -50,
		.secured = true,
		.freshness = CHAN_FRESH,
	};
	bool digits = false;

	chan_stats_reset(&one);
	zassert_ok(chan_stats_add(&one, &ap));
	ui_show(UI_VIEW_NETWORKS, CHAN_BAND_2G4, &one, 1, 0, true);

	for (int y = LIST_TOP + 2; y < LIST_TOP + 2 + 16; y++) {
		for (int x = LIST_NAME_W; x < LIST_CHAN_X; x++) {
			zassert_equal(fake_display_pixel(x, y), gfx_rgb(0, 0, 0),
				      "gap after the name at %d,%d", x, y);
		}
		for (int x = LIST_CHAN_X; x < LIST_CHAN_X + (2 * 10); x++) {
			digits = digits || fake_display_pixel(x, y) != gfx_rgb(0, 0, 0);
		}
	}
	zassert_true(digits, "the channel's \"11\" starts after the gap");
}


/**
 * @brief More networks than fit a page: the second page starts with the
 *        10th strongest, and a page past the end is pulled back to the last.
 *
 * @sideeffects Draws on the fake panel and saves the second page to
 *              out/screens/networks-page2.ppm. errno may be set by snprintf() (only on an output
 *              error).
 */
ZTEST(meter_ui, test_network_pages)
{
	static struct chan_stats many;
	uint16_t green = gfx_rgb(0, 200, 80);
	uint16_t red = gfx_rgb(230, 40, 40);

	zassert_equal(ui_list_rows(), 9, "196 pixels of list, 20 to a row");
	chan_stats_reset(&many);
	for (uint8_t i = 0; i < 13; i++) {
		struct chan_ap ap = {
			.bssid = {0x02, 0x1f, 0x3c, 0xa2, 0x7f, i},
			.channel = (uint8_t)(1U + (i % 13U)),
			.rssi = (int8_t)(-40 - (4 * i)), /* 0-5 green, 6-8 amber, 9-12 red */
			.secured = true,
			.freshness = CHAN_FRESH,
		};

		(void)snprintf(ap.ssid, sizeof(ap.ssid), "Network %u", (unsigned int)i + 1U);
		zassert_ok(chan_stats_add(&many, &ap));
	}

	ui_show(UI_VIEW_NETWORKS, CHAN_BAND_2G4, &many, 1, 0, true);
	zassert_true(row_has_colour(LIST_TOP + 2, LIST_RSSI_X, 320, green), "page 1: strongest");

	ui_show(UI_VIEW_NETWORKS, CHAN_BAND_2G4, &many, 1, 9, true);
	zassert_true(row_has_colour(LIST_TOP + 2, LIST_RSSI_X, 320, red), "page 2: 10th, red");
	zassert_true(
		row_has_colour(LIST_TOP + (3 * 20) + 2, 0, LIST_NAME_W, gfx_rgb(255, 255, 255)),
		"13th on the fourth row");
	zassert_false(row_has_colour(LIST_TOP + (4 * 20) + 2, 0, 320, gfx_rgb(255, 255, 255)),
		      "nothing after the 13th");
	(void)fake_display_save_ppm("out/screens/networks-page2.ppm");

	ui_show(UI_VIEW_NETWORKS, CHAN_BAND_2G4, &many, 1, 30, true);
	zassert_true(row_has_colour(LIST_TOP + 2, LIST_RSSI_X, 320, red),
		     "past the end: last page");
	zassert_false(row_has_colour(LIST_TOP + (4 * 20) + 2, 0, 320, gfx_rgb(255, 255, 255)));
}


/**
 * @brief Left edge of a 5 GHz channel's column on the chart.
 *
 * @param i The channel's place: 0 for 36, ..., 23 for 161.
 * @return x.
 *
 * @sideeffects None; errno unchanged.
 */
static int column_x_5g(int i)
{
	return X0_5G + (i * 10) + ((i / 4) * 6);
}


/**
 * @brief Fill in a dual-band scan like a real one: a strong 80 MHz network
 *        on 40 (36-48 busy) and one of unknown width, two 80 MHz ones on 100
 *        and a 20 MHz one on 104 (100-112 moderate), a weak 40 MHz one on
 *        149, nothing on 52-64 or 116-128, and one 2.4 GHz network.
 *
 * @param[out] s The scan.
 *
 * @sideeffects None (writes only through @p s). errno may be set by snprintf() (only on an
 *              output error).
 */
static void fill_dual_band(struct chan_stats *s)
{
	static const struct {
		uint8_t channel;
		uint8_t width;
		uint8_t centre;
		int8_t rssi;
		const char *ssid;
	} aps[] = {
		{40, CHAN_WIDTH_80, 42, -44, "HomeNetwork-5G"},
		{40, CHAN_WIDTH_UNKNOWN, 0, -82, "Neighbour-5G"},
		{100, CHAN_WIDTH_80, 106, -76, "Office"},
		{100, CHAN_WIDTH_80, 106, -78, "Office-Guest"},
		{104, CHAN_WIDTH_20, 104, -92, ""},
		{149, CHAN_WIDTH_40, 151, -88, "Shed"},
	};
	struct chan_ap ap = {
		.bssid = {0x02, 0x1f, 0x3c, 0xa2, 0x50, 0},
		.channel = 6,
		.rssi = -70,
		.secured = true,
		.freshness = CHAN_FRESH,
	};

	chan_stats_reset(s);
	(void)snprintf(ap.ssid, sizeof(ap.ssid), "2.4 GHz only");
	zassert_ok(chan_stats_add(s, &ap));
	ap.band = CHAN_BAND_5G;
	for (size_t i = 0; i < ARRAY_SIZE(aps); i++) {
		ap.bssid[5] = (uint8_t)(i + 1U);
		ap.channel = aps[i].channel;
		ap.width = aps[i].width;
		ap.centre = aps[i].centre;
		ap.rssi = aps[i].rssi;
		(void)snprintf(ap.ssid, sizeof(ap.ssid), "%s", aps[i].ssid);
		zassert_ok(chan_stats_add(s, &ap));
	}
}


/**
 * @brief The 5 GHz chart: an 80 MHz network fills its whole block and a
 *        40 MHz one two columns, coloured by how busy they are; empty blocks
 *        have no bars; the quietest allowed block's label is highlighted;
 *        2.4 GHz networks don't appear.
 *
 * @sideeffects Overwrites its own static scan; draws on the fake panel and saves it to
 *              out/screens/channels-5g.ppm. errno may be set by snprintf() (only on an output
 *              error).
 */
ZTEST(meter_ui, test_channels_5g)
{
	static struct chan_stats s;
	uint16_t red = gfx_rgb(230, 40, 40);
	uint16_t amber = gfx_rgb(255, 170, 0);
	uint16_t black = gfx_rgb(0, 0, 0);

	fill_dual_band(&s);
	ui_show(UI_VIEW_CHANNELS, CHAN_BAND_5G, &s, 1, 0, true);

	zassert_equal(fake_display_pixel(column_x_5g(1) + 5, CHART_BOTTOM - 1), red,
		      "40: its own network, bright red (-44 dBm: busy)");
	zassert_equal(fake_display_pixel(column_x_5g(0) + 5, CHART_BOTTOM - 1), gfx_fade(red, 153),
		      "36: the 80 MHz block's network, dim");
	zassert_equal(fake_display_pixel(column_x_5g(3) + 5, CHART_BOTTOM - 1), gfx_fade(red, 153),
		      "48: still in the block");
	zassert_equal(fake_display_pixel(column_x_5g(8) + 5, CHART_BOTTOM - 1), amber,
		      "100: -76 and -78 make -74 dBm, moderate");
	zassert_equal(fake_display_pixel(column_x_5g(4) + 5, CHART_BOTTOM - 1), black,
		      "52-64: nothing heard");
	zassert_not_equal(fake_display_pixel(column_x_5g(21) + 5, CHART_BOTTOM - 1), black,
			  "153: the 40 MHz network on 149's secondary");
	zassert_equal(fake_display_pixel(column_x_5g(22) + 5, CHART_BOTTOM - 1), black,
		      "157: beyond the 40 MHz network");
	zassert_equal(fake_display_pixel(column_x_5g(4) - 3, CHART_BOTTOM - 1), black,
		      "the gap between blocks");
	zassert_equal(fake_display_pixel(column_x_5g(4), CHART_BOTTOM + 4), gfx_rgb(0, 210, 255),
		      "52-64 recommended: the quietest, though DFS");
	zassert_equal(fake_display_pixel(column_x_5g(0), CHART_BOTTOM + 4), black,
		      "36-48 not highlighted");
	zassert_equal(chan_stats_recommend_5g(&s, chan_5g_blocks(false, false)), 52);
	(void)fake_display_save_ppm("out/screens/channels-5g.ppm");
}


/**
 * @brief The 5 GHz network list: only 5 GHz networks, strongest first,
 *        and a three-digit channel fits its column, clear of the signal
 *        strength.
 *
 * @sideeffects Overwrites its own static scan; draws on the fake panel and saves it to
 *              out/screens/networks-5g.ppm. errno may be set by snprintf() (only on an output
 *              error).
 */
ZTEST(meter_ui, test_networks_5g)
{
	static struct chan_stats s;
	uint16_t white = gfx_rgb(255, 255, 255);
	bool digits = false;

	fill_dual_band(&s);
	ui_show(UI_VIEW_NETWORKS, CHAN_BAND_5G, &s, 1, 0, true);

	zassert_true(row_has_colour(LIST_TOP + 2, LIST_RSSI_X, 320, gfx_rgb(0, 200, 80)),
		     "first: -44 dBm, green");
	zassert_true(
		row_has_colour(LIST_TOP + (5 * 20) + 2, 0, LIST_NAME_W, gfx_rgb(150, 150, 150)),
		"sixth and last: the hidden network on 104");
	zassert_false(row_has_colour(LIST_TOP + (6 * 20) + 2, 0, 320, white),
		      "the 2.4 GHz network isn't listed");

	/* Row 2: "Office" on 100 at -76 dBm */
	for (int y = LIST_TOP + 20 + 2; y < LIST_TOP + 20 + 2 + 16; y++) {
		for (int x = LIST_CHAN_X; x < LIST_RSSI_X; x++) {
			digits = digits || fake_display_pixel(x, y) != gfx_rgb(0, 0, 0);
		}
		for (int x = LIST_RSSI_X; x < LIST_RSSI_X + 10; x++) {
			zassert_equal(fake_display_pixel(x, y), gfx_rgb(0, 0, 0),
				      "space before \"-76\" at %d,%d", x, y);
		}
	}
	zassert_true(digits, "\"100\" in the channel column");

	/* Row 1: "40", right-aligned under the "100" below it: its first character cell is empty */
	for (int y = LIST_TOP + 2; y < LIST_TOP + 2 + 16; y++) {
		for (int x = LIST_CHAN_X; x < LIST_CHAN_X + 10; x++) {
			zassert_equal(fake_display_pixel(x, y), gfx_rgb(0, 0, 0),
				      "\"40\" right-aligned: blank at %d,%d", x, y);
		}
	}
	(void)fake_display_save_ppm("out/screens/networks-5g.ppm");

	ui_show(UI_VIEW_NETWORKS, CHAN_BAND_2G4, &s, 1, 0, true);
	zassert_true(row_has_colour(LIST_TOP + 2, LIST_RSSI_X, 320, gfx_rgb(255, 170, 0)),
		     "2.4 GHz list: its one network, -70 dBm, amber");
	zassert_false(row_has_colour(LIST_TOP + 20 + 2, 0, 320, white), "and no 5 GHz ones");
}


/* Starts for the events screen, newest first. */
static const struct boot_record test_events[] = {
	{.boot = 14, .cause = BOOT_POWER_ON},
	{.boot = 13, .cause = BOOT_WIFI_RESTART, .uptime_s = 9060, .detail = -11, .arg = 5},
	{.boot = 12, .cause = BOOT_WIFI_RESTART, .uptime_s = 7380, .detail = -11, .arg = 5},
	{.boot = 11, .cause = BOOT_WATCHDOG, .uptime_s = 41000, .detail = BOOT_WATCHED_SCAN},
	{.boot = 10, .cause = BOOT_CRASH, .uptime_s = 600, .detail = 3, .arg = 0x10001234},
	{.boot = 9, .cause = BOOT_UNEXPLAINED, .uptime_s = 3600},
	{.boot = 8, .cause = BOOT_POWER_ON},
};

/**
 * @brief Get one of the test's events (ui_event_get_fn).
 *
 * @param i 0 for the newest.
 * @return The event, or NULL past the end.
 *
 * @sideeffects None; errno unchanged.
 */
static const struct boot_record *test_event(size_t i)
{
	return i < ARRAY_SIZE(test_events) ? &test_events[i] : NULL;
}


/**
 * @brief The events screen lists starts newest first, coloured by how much
 *        they matter; with none logged, it says so.
 *
 * @sideeffects Draws on the fake panel, saves it to out/screens/events.ppm, and sets the UI's
 *              event source. errno may be set by snprintf() (only on an output error).
 */
ZTEST(meter_ui, test_events_screen)
{
	uint16_t white = gfx_rgb(255, 255, 255);
	uint16_t amber = gfx_rgb(255, 170, 0);
	uint16_t red = gfx_rgb(230, 40, 40);

	ui_set_events(ARRAY_SIZE(test_events), test_event);
	ui_show(UI_VIEW_EVENTS, CHAN_BAND_2G4, &stats, 5, 0, true);
	zassert_true(row_has_colour(LIST_TOP + 2, 0, 320, white), "power on: white");
	zassert_true(row_has_colour(LIST_TOP + 20 + 2, 0, 320, amber), "Wi-Fi restart: amber");
	zassert_true(row_has_colour(LIST_TOP + (3 * 20) + 2, 0, 320, red), "hung thread: red");
	zassert_false(row_has_colour(LIST_TOP + (7 * 20) + 2, 0, 320, white), "7 events only");
	(void)fake_display_save_ppm("out/screens/events.ppm");

	ui_set_events(0, NULL);
	ui_show(UI_VIEW_EVENTS, CHAN_BAND_2G4, &stats, 5, 0, true);
	zassert_true(row_has_colour(LIST_TOP + 2, 0, 320, gfx_rgb(150, 150, 150)),
		     "\"No events logged\", in grey");
}


ZTEST_SUITE(meter_ui, NULL, setup, NULL, NULL, NULL);
```

## src/fake_display.c
```c
/*
 * Copyright (c) 2026 Rob McKay
 *
 * SPDX-License-Identifier: Apache-2.0
 */

#define DT_DRV_COMPAT meter_test_display

#include <errno.h>
#include <stdio.h>
#include <string.h>
#include <stdint.h>

#include <zephyr/device.h>
#include <zephyr/drivers/display.h>
#include <zephyr/sys/byteorder.h>
#include <zephyr/devicetree.h>
#include <zephyr/toolchain.h>

#include <nsi_host_trampolines.h>

#include "fake_display.h"

#define WIDTH  DT_INST_PROP(0, width)
#define HEIGHT DT_INST_PROP(0, height)

/* Host open() flags for an existing file: O_WRONLY | O_TRUNC on Linux, the
 * only host the tests run on (the Docker image).
 */
#define HOST_O_WRONLY_TRUNC 01001

static uint16_t pixels[WIDTH * HEIGHT];

/**
 * @brief Copy a block of pixels to the panel.
 *
 * @param dev The panel.
 * @param x Left edge.
 * @param y Top edge.
 * @param desc Size and pitch of @p buf.
 * @param buf Pixels.
 * @retval 0 Written.
 * @retval -EINVAL The block is not on the panel.
 *
 * @sideeffects Writes the pixels into the fake panel's memory (@c pixels). errno unchanged.
 */
static int fake_write(const struct device *dev, const uint16_t x, const uint16_t y,
		      const struct display_buffer_descriptor *desc, const void *buf)
{
	const uint16_t *src = buf;

	ARG_UNUSED(dev);
	if (x + desc->width > WIDTH || y + desc->height > HEIGHT) {
		return -EINVAL;
	}
	for (uint16_t row = 0; row < desc->height; row++) {
		memcpy(&pixels[((size_t)(y + row) * WIDTH) + x], &src[(size_t)row * desc->pitch],
		       desc->width * sizeof(pixels[0]));
	}

	return 0;
}


/**
 * @brief Describe the panel.
 *
 * @param dev The panel.
 * @param[out] caps Its size and pixel format.
 *
 * @sideeffects None (writes only through @p caps); errno unchanged.
 */
static void fake_get_capabilities(const struct device *dev, struct display_capabilities *caps)
{
	ARG_UNUSED(dev);
	memset(caps, 0, sizeof(*caps));
	caps->x_resolution = WIDTH;
	caps->y_resolution = HEIGHT;
	caps->supported_pixel_formats = PIXEL_FORMAT_RGB_565X;
	caps->current_pixel_format = PIXEL_FORMAT_RGB_565X;
}


/**
 * @brief Turn the panel on: nothing to do.
 *
 * @param dev The panel.
 * @return 0.
 *
 * @sideeffects None; errno unchanged.
 */
static int fake_blanking_off(const struct device *dev)
{
	ARG_UNUSED(dev);

	return 0;
}


static DEVICE_API(display, fake_api) = {
	.write = fake_write,
	.get_capabilities = fake_get_capabilities,
	.blanking_off = fake_blanking_off,
};

/* Zephyr's definition macro can end in an empty statement: ISO C -Wpedantic
 * flags the ';' as extra. Nothing else is exempted.
 */
#pragma GCC diagnostic push
#pragma GCC diagnostic ignored "-Wpedantic"
DEVICE_DT_INST_DEFINE(0, NULL, NULL, NULL, NULL, POST_KERNEL, CONFIG_DISPLAY_INIT_PRIORITY,
		      &fake_api);
#pragma GCC diagnostic pop

/*
 * Public interface: documented in fake_display.h.
 */
uint16_t fake_display_pixel(int x, int y)
{
	return pixels[(y * WIDTH) + x];
}


/*
 * Public interface: documented in fake_display.h.
 *
 * Uses native_sim's host trampolines (nsi_host_*). The open() flags are the host's (Linux)
 * values, and the file must already exist, as the trampolines give no way to set a new file's
 * permissions.
 */
int fake_display_save_ppm(const char *path)
{
	char header[32];
	uint8_t row[WIDTH * 3];
	int fd = nsi_host_open(path, HOST_O_WRONLY_TRUNC);
	int len = snprintf(header, sizeof(header), "P6\n%d %d\n255\n", WIDTH, HEIGHT);
	int ret = 0;

	if (fd < 0) {
		return -ENOENT;
	}
	if (nsi_host_write(fd, header, (unsigned long)len) != len) {
		ret = -EIO;
	}
	for (int y = 0; y < HEIGHT && ret == 0; y++) {
		for (int x = 0; x < WIDTH; x++) {
			unsigned int px = sys_be16_to_cpu(pixels[(y * WIDTH) + x]);

			row[(x * 3) + 0] = (uint8_t)((px >> 8U) & 0xf8U);
			row[(x * 3) + 1] = (uint8_t)((px >> 3U) & 0xfcU);
			row[(x * 3) + 2] = (uint8_t)((px << 3U) & 0xf8U);
		}
		if (nsi_host_write(fd, row, sizeof(row)) != (long)sizeof(row)) {
			ret = -EIO;
		}
	}
	(void)nsi_host_close(fd);

	return ret;
}
```

## src/fake_display.h
```c
/*
 * Copyright (c) 2026 Rob McKay
 *
 * SPDX-License-Identifier: Apache-2.0
 *
 * An in-memory panel for the UI tests (meter,test-display): it keeps every
 * pixel written to it.
 */

#ifndef METER_FAKE_DISPLAY_H_
#define METER_FAKE_DISPLAY_H_

#include <stdint.h>

/**
 * @brief Read a pixel of the fake panel.
 *
 * @param x Column.
 * @param y Row.
 * @return The pixel, RGB565 high byte first, as written.
 *
 * @sideeffects None; errno unchanged.
 */
uint16_t fake_display_pixel(int x, int y);

/**
 * @brief Save the fake panel as a binary PPM image.
 *
 * Writes only to a file that already exists (native_sim's host calls give
 * no way to set a new file's permissions): scripts/test.sh creates them.
 *
 * @param path File on the host.
 * @retval 0 Saved.
 * @retval -ENOENT No such file.
 * @retval -EIO A write failed.
 *
 * @sideeffects Overwrites the host file @p path. errno may be set by snprintf() (only on an
 *              output error). The host file calls set the host C library's errno, not this one.
 */
int fake_display_save_ppm(const char *path);

#endif /* METER_FAKE_DISPLAY_H_ */
```
