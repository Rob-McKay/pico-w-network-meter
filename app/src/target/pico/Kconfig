## app/src/target/pico/Kconfig
```kconfig
# Copyright (c) 2026 Rob McKay
# SPDX-License-Identifier: Apache-2.0
#
# Options for the Raspberry Pi Pico W target only.

config METER_WIFI_KEEP_AWAKE
	bool "Keep the Wi-Fi chip out of its deep sleep"
	default y
	depends on WIFI_AIROC
	help
	  Between requests the Wi-Fi driver lets the CYW43439 go into its
	  save/restore deep sleep, and every few hours it fails to wake
	  properly, so every scan fails until the meter restarts. This
	  asks the driver to keep the chip's bus up between scans, so the
	  chip never goes into deep sleep (src/target/pico/wifi_awake.c,
	  with the carried hal_infineon patch that makes it possible). It
	  uses more power: turn it off to stretch a battery, and the meter
	  will restart every few hours instead.

config METER_RESET_CAUSE_RP2040
	bool "Record whether the hardware watchdog reset the Pico"
	default y
	depends on SOC_RP2040
	select METER_RESET_CAUSE
	help
	  Reads the RP2040's watchdog reason register at start-up and keeps
	  it in the start's record, so a restart the hardware watchdog made
	  shows as "HW watchdog after ..." rather than "restart after ..."
	  (src/target/pico/reset_cause_rp2040.c). Zephyr's hwinfo driver
	  doesn't read that register on the RP2040.

config METER_USB_CONSOLE_FLOW
	bool "Console flow control that follows DTR"
	default y
	depends on USBD_CDC_ACM_CLASS
	help
	  The Pico's console is a CDC-ACM port on its own USB socket
	  (boards/rpi_pico_rp2040_w.conf and .overlay). Its driver drops
	  output it can't buffer at once, or with flow control waits for
	  ever when no host is reading. This turns flow control on only
	  while a terminal has the port open, following DTR
	  (src/target/pico/usb_console.c).
```

## tests/meter_units/testcase.yaml
```yaml
tests:
  meter.units:
    platform_allow:
      - native_sim/native/64
    tags: meter
```

## tests/ui_render/testcase.yaml
```yaml
# Copyright (c) 2026 Rob McKay
# SPDX-License-Identifier: Apache-2.0

tests:
  meter.ui_render:
    platform_allow:
      - native_sim/native/64
    tags: meter
```

## tests/wifi_buffers/testcase.yaml
```yaml
# Copyright (c) 2026 Rob McKay
# SPDX-License-Identifier: Apache-2.0

tests:
  meter.wifi_buffers:
    platform_allow:
      - native_sim/native/64
    tags: meter
```
